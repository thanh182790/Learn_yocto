## 03-spi/meta-kernelmodule/conf/layer.conf
```bitbake
# We have a conf and classes directory, add to BBPATH
BBPATH .= ":${LAYERDIR}"

# We have recipes-* directories, add to BBFILES
BBFILES += "${LAYERDIR}/recipes-*/*/*.bb \
            ${LAYERDIR}/recipes-*/*/*.bbappend"

BBFILE_COLLECTIONS += "meta-kernelmodule"
BBFILE_PATTERN_meta-kernelmodule = "^${LAYERDIR}/"
BBFILE_PRIORITY_meta-kernelmodule = "6"

LAYERDEPENDS_meta-kernelmodule = "core"
LAYERSERIES_COMPAT_meta-kernelmodule = "dunfell"
```
